// Copyright 2023 QMK
// SPDX-License-Identifier: GPL-2.0-or-later

#include QMK_KEYBOARD_H

enum layer_names {
    _BASE,
    _L1,
    _L2,
    _L3
};

// Hardcoded Baseline Keys Matrix
const uint16_t PROGMEM keymaps[][MATRIX_ROWS][MATRIX_COLS] = {
    [_BASE] = LAYOUT(
        KC_MUTE, KC_P8,   KC_P4,
        KC_P5,   KC_P6
    ),
    [_L1] = LAYOUT(
        KC_TRNS, KC_TRNS, KC_TRNS,
        KC_TRNS, KC_TRNS
    ),
    [_L2] = LAYOUT(
        KC_TRNS, KC_TRNS, KC_TRNS,
        KC_TRNS, KC_TRNS
    ),
    [_L3] = LAYOUT(
        KC_TRNS, KC_TRNS, KC_TRNS,
        KC_TRNS, KC_TRNS
    )
};

// Hardcoded Rotary Knob Mappings
const uint16_t PROGMEM encoder_map[][NUM_ENCODERS][NUM_DIRECTIONS] = {
    [_BASE] = { ENCODER_CCW_CW(KC_VOLD, KC_VOLU) },
    [_L1]   = { ENCODER_CCW_CW(KC_TRNS, KC_TRNS) },
    [_L2]   = { ENCODER_CCW_CW(KC_TRNS, KC_TRNS) },
    [_L3]   = { ENCODER_CCW_CW(KC_TRNS, KC_TRNS) }
};

#ifdef OLED_ENABLE
// Frame 1: Resting (Both paws on desk)
static const char PROGMEM bongo_rest[] = {
    0x00,0x00,0x00,0x00,0x00,0x00,0x00,0x00,0x00,0x00,0x00,0x00,0x00,0x00,0x00,0x00,
    0x00,0x00,0x00,0x00,0x00,0x00,0x00,0x00,0x80,0xc0,0xe0,0x70,0x38,0x18,0x1c,0x0c,
    0x0c,0x0c,0x0c,0x0c,0x1c,0x18,0x38,0x70,0xe0,0xc0,0x80,0x00,0x00,0x00,0x00,0x00,
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    0x00,0x00,0x00,0x00,0x00,0x00,0x00,0x00,0x00,0x00,0x00,0x00,0x00,0x00,0x00,0x00
};

// Frame 2: Tapping (Alternating active paw movement layout)
static const char PROGMEM bongo_tap[] = {
    0x00,0x00,0x00,0x00,0x00,0x00,0x00,0x00,0x00,0x00,0x00,0x00,0x00,0x00,0x00,0x00,
    0x00,0x00,0x00,0x00,0x00,0x00,0x00,0x00,0x80,0xc0,0xe0,0x70,0x38,0x18,0x1c,0x0c,
    0x0c,0x0c,0x0c,0x0c,0x1c,0x18,0x38,0x70,0xe0,0xc0,0x80,0x00,0x00,0x00,0x00,0x00,
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    0x00,0x00,0x00,0x00,0x00,0x00,0x00,0x00,0x00,0x00,0x00,0x00,0x00,0x00,0x00,0x00
};

bool oled_task_user(void) {
    if (last_input_activity_elapsed() > 60000) {
        oled_off();
        return false;
    } else {
        oled_on();
    }
    
    // Switch frames smoothly based on your input activity clock
    if (last_input_activity_elapsed() < 250) {
        oled_write_raw_P(bongo_tap, sizeof(bongo_tap));
    } else {
        oled_write_raw_P(bongo_rest, sizeof(bongo_rest));
    }
    return false;
}
#endif

// Smooth reactive lighting engine handlers
uint16_t white_flash_timer = 0;
uint8_t current_brightness = 0;

void keyboard_post_init_user(void) {
    rgblight_enable_noeeprom();
    rgblight_mode_noeeprom(RGBLIGHT_MODE_STATIC_LIGHT);
    rgblight_sethsv_noeeprom(0, 0, 0);
}

bool process_record_user(uint16_t keycode, keyrecord_t *record) {
    if (record->event.pressed) {
        current_brightness = 255;
        rgblight_sethsv_noeeprom(0, 0, current_brightness);
        white_flash_timer = timer_read();
    }
    return true;
}

void matrix_scan_user(void) {
    if (current_brightness > 0) {
        if (timer_elapsed(white_flash_timer) > 3) {
            current_brightness = (current_brightness > 5) ? (current_brightness - 5) : 0;
            rgblight_sethsv_noeeprom(0, 0, current_brightness);
            white_flash_timer = timer_read();
        }
    }
}